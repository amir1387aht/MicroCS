## Kconfig
```kconfig
# MicroCS - ESP-IDF component configuration (idf.py menuconfig > Component config > MicroCS).
# (Zephyr uses zephyr/Kconfig; plain CMake uses MICROCS_PROFILE.)
# Every other option goes into the project config header mcs_user_config.h.
menu "MicroCS"

    config MICROCS_VM_HEAP_KB
        int "Example firmware: VM pool ceiling (KiB)"
        range 16 1024
        default 192
        help
            Combined backing-byte ceiling for the example's automatic regions.
            Memory grows on demand; native driver/radio headroom is rechecked
            for each region. Actual capacity can remain below the ceiling.
            Allocation failure reports OOM; no unbounded fallback is used.
            For the small OLED Project regression use 40 and leave execution ceilings at defaults.
            SDK/FreeRTOS, static RAM and task stacks are outside this pool.

    config MICROCS_VM_STACK_SLOTS
        int "Example firmware: maximum VM value stack slots (0 = profile default)"
        range 0 65535
        default 0
        help
            Execution ceiling, not an upfront reservation or feature/profile switch.
            Starts at up to 32 slots and grows automatically as needed.
            Zero preserves the profile ceiling; no manual sizing is needed
            for normal applications within that ceiling.


    config MICROCS_VM_MAX_FRAMES
        int "Example firmware: maximum VM call frames (0 = profile default)"
        range 0 65535
        default 0
        help
            Execution call-depth ceiling. Starts at one frame and grows automatically.
            Zero preserves the selected profile's call-depth limit.

    config MICROCS_USER_CONFIG_FILE
        string "Project config header (mcs_user_config.h)"
        default ""
        help
            Path of the header with your MCS_* options (template:
            config/mcs_user_config.h in MicroCS), absolute or relative to the
            project folder. Empty: mcs_user_config.h in the project folder,
            its main/ or include/ folder is used when it exists. NONE: no
            config header. The choices in this menu win over the header,
            except the build profile: MCS_PROFILE in the header wins.

    choice MICROCS_PROFILE
        prompt "Build profile"
        default MICROCS_PROFILE_EMBEDDED if IDF_TARGET_ESP32C2
        default MICROCS_PROFILE_FULL
        help
            Feature set of the C# runtime (include/profiles/mcs_profile_<name>.h).
            The default follows the chip's RAM: the ESP32-C2 (272 KB SRAM) gets
            the embedded profile, every other ESP32 the full build.
            MCS_PROFILE in mcs_user_config.h overrides this choice.

        config MICROCS_PROFILE_FULL
            bool "Full (default configuration: compiler, REPL, disassembler, 64-bit ints)"
        config MICROCS_PROFILE_EMBEDDED
            bool "Embedded (compiler + REPL + modules, 32-bit ints, no disassembler)"
        config MICROCS_PROFILE_MCU
            bool "MCU runtime (precompiled images only)"
        config MICROCS_PROFILE_LOWRAM
            bool "Low-RAM (precompiled images, single-precision floats, small VM limits)"
        config MICROCS_PROFILE_MIN
            bool "Minimal (smallest flash; no floats, LINQ, Dictionary, extra string/array members)"
    endchoice

    choice MICROCS_FS
        prompt "Filesystem on the \"storage\" partition"
        default MICROCS_FS_LITTLEFS
        help
            Where uploaded scripts and C# File/Directory files live.

        config MICROCS_FS_LITTLEFS
            bool "LittleFS (esp_littlefs component, BSD; C code can fopen() the files too)"
        config MICROCS_FS_TINYFS
            bool "TinyFS (built in, MIT; no extra sources)"
            help
                MicroCS's own small power-fail-safe flash filesystem on the
                "storage" partition (mcs_vfs_tinyfs.c). Nothing to download or
                link; files are visible to C# only (not to fopen()).
        config MICROCS_FS_YAFFS2
            bool "YAFFS2 (GPLv2 or commercial licence - see help)"
            help
                The yaffs2 sources are not bundled: set the MICROCS_YAFFS2_DIR
                environment / CMake variable to a yaffs2 checkout (the folder
                with direct/ and core/), or put one in <project>/third_party/yaffs2,
                or allow the pinned revision to
                be downloaded with MICROCS_FS_DOWNLOAD=1 (environment) /
                -DMICROCS_FS_DOWNLOAD=ON. Linking YAFFS2 puts the firmware under
                the GPLv2 (or a commercial licence from Aleph One).
    endchoice

    config MICROCS_WS2812
        bool "WS2812 / NeoPixel driver (C# LedStrip, RMT)"
        default y
        help
            The built-in "ws2812" driver: C# LedStrip on any GPIO through an RMT
            channel per strip. Turn it off to save ~3 KB of flash when no
            addressable LEDs are used (Hal.Has("LedStrip") is then false).

    menuconfig MICROCS_WIFI
        bool "Wi-Fi and networking (C# Wifi, EspNow, TcpClient, UdpClient, Http, Ntp)"
        default y
        depends on SOC_WIFI_SUPPORTED
        help
            The C# networking classes (docs/NETWORK.md): Wifi (station, soft-AP,
            scan, static IP, power save, TX power, WPA2/WPA3-Enterprise, saved
            networks), EspNow, Ntp, Ping, Dns, TcpClient / TcpListener /
            UdpClient on lwIP sockets and Http with HTTPS through esp-tls and the
            certificate bundle. Mdns appears when the project has the
            espressif/mdns component. The Wi-Fi driver is only started by the
            first Wifi / EspNow call (or the boot connection below). Off: ~150 KB
            less flash.

    if MICROCS_WIFI
    config MICROCS_WIFI_RESERVE_KB
        int "RAM kept free for the Wi-Fi driver (KB)"
        default 56 if IDF_TARGET_ESP32C2
        default 72
        range 0 256
        help
            The example firmware sizes the C# heap so that this much RAM stays
            free for the Wi-Fi driver, lwIP and TLS (an HTTPS connection needs
            ~40 KB while it is open). 0 = no reservation.

    config MICROCS_WIFI_SSID
        string "Connect at boot: network name (SSID)"
        default ""
        help
            Join this network in the background at boot. Empty: use the network
            saved with Wifi.Save(ssid, password) (see the next option).

    config MICROCS_WIFI_PASSWORD
        string "Connect at boot: password"
        default ""

    config MICROCS_WIFI_AUTOCONNECT
        bool "Connect at boot to the network saved with Wifi.Save()"
        default y
        help
            With an empty SSID above: if a C# script stored credentials with
            Wifi.Save(ssid, password) (NVS), the firmware joins that network in the
            background at every boot. Wifi.Forget() removes them.
    endif

    menu "Bluetooth LE"
        depends on SOC_BLE_SUPPORTED

    comment "Enable Bluetooth and choose NimBLE under Component config > Bluetooth"
        depends on !BT_ENABLED || !BT_NIMBLE_ENABLED
    comment "Enable the Bluetooth controller and disable NimBLE extended advertising"
        depends on BT_NIMBLE_ENABLED && (!BT_CONTROLLER_ENABLED || BT_NIMBLE_EXT_ADV)

    config MICROCS_BLE
        bool "Bluetooth LE (C# Ble, BleService, BleConnection, BleUart on NimBLE)"
        default n
        depends on BT_ENABLED && BT_NIMBLE_ENABLED && BT_CONTROLLER_ENABLED && !BT_NIMBLE_EXT_ADV
        select BT_NIMBLE_ROLE_CENTRAL
        select BT_NIMBLE_ROLE_PERIPHERAL
        select BT_NIMBLE_ROLE_BROADCASTER
        select BT_NIMBLE_ROLE_OBSERVER
        help
            The C# Bluetooth Low Energy classes (docs/BLE.md): advertising and
            beacons (iBeacon / Eddystone), scanning, a GATT server built from
            C# (BleService / BleCharacteristic with notify / indicate), the
            central role with a GATT client, pairing / bonding and BleUart
            (Nordic UART Service). Needs Component config > Bluetooth enabled
            with the NimBLE host (CONFIG_BT_ENABLED, CONFIG_BT_NIMBLE_ENABLED),
            legacy advertising (CONFIG_BT_NIMBLE_EXT_ADV off). Enabled for BLE-capable
            release targets; costs ~110 KB of flash and ~40 KB of RAM.

    config MICROCS_BLE_RESERVE_KB
        int "RAM kept free for the Bluetooth stack (KB)"
        depends on MICROCS_BLE
        default 48
        range 0 256
        help
            The example firmware sizes the C# heap so that this much RAM stays
            free for NimBLE and the controller, which start on the first Ble
            call. 0 = no reservation.

    if MICROCS_BLE
    config MICROCS_BLE_NAME
        string "Default BLE device name"
        default "MicroCS"

    config MICROCS_BLE_QUEUE
        int "Event queue (bytes)"
        default 2048
        range 256 65535

    config MICROCS_BLE_MAX_SERVICES
        int "Local GATT services"
        default 8
        range 1 32

    config MICROCS_BLE_MAX_ATTRS
        int "Local characteristics and descriptors"
        default 32
        range 1 128

    config MICROCS_BLE_VALUE_POOL
        int "Local attribute value pool (bytes)"
        default 2048
        range 128 65535

    config MICROCS_BLE_MAX_VALUE
        int "Largest attribute value (bytes)"
        default 512
        range 20 512

    config MICROCS_BLE_SCAN_MAX
        int "Devices returned by a scan"
        default 32
        range 1 128

    config MICROCS_BLE_MAX_DISC
        int "Results per GATT discovery"
        default 32
        range 1 128

    config MICROCS_BLE_MAX_SUBS
        int "Remote notification subscriptions"
        default 8
        range 1 32

    config MICROCS_BLE_SCAN_INTERVAL
        int "Default scan interval (ms)"
        default 100
        range 5 10240

    config MICROCS_BLE_SCAN_WINDOW
        int "Default scan window (ms)"
        default 50
        range 5 MICROCS_BLE_SCAN_INTERVAL
        help
            Radio receive time per interval. Lower values reduce scan duty cycle.
            Scripts can override these with Ble.ScanInterval and Ble.ScanWindow.

    config MICROCS_BLE_TIMEOUT
        int "GATT operation timeout (ms)"
        default 5000
        range 100 120000

    config MICROCS_BLE_CONNECT_TIMEOUT
        int "Connection timeout (ms)"
        default 10000
        range 100 120000

    config MICROCS_BLE_UART_RX
        int "BleUart receive buffer (bytes)"
        default 512
        range 32 65535

    comment "Connections, preferred MTU, security and bonds: Bluetooth > NimBLE Options"
    endif
    endmenu

    comment "Bluetooth LE unavailable: this chip has no onboard BLE radio"
        depends on !SOC_BLE_SUPPORTED

    config MICROCS_THREADS
        bool "Real threads on FreeRTOS tasks (C# Thread.Run / RunOn, both cores)"
        default n
        help
            C# scripts and functions on their own FreeRTOS tasks: Thread.Start,
            Thread.Run, Thread.RunOn(core, ...) pins work to a core (core 1 of
            the ESP32 / ESP32-S3 runs in parallel with the REPL on core 0),
            Thread.Every for OS-timed periodic tasks, Channels between them,
            and `thread core=1` jobs in jobs.cfg. Every thread has its own VM
            and heap (MCS_THREAD_HEAP, default 32 KB) and task stack
            (MCS_THREAD_STACK, default 12 KB). Off: MicroCS stays the
            single-threaded runtime (Thread.Os == "None"). See docs/THREADS.md.

    config MICROCS_ENCODER
        bool "Rotary encoders (hardware PCNT, GPIO fallback)"
        default y
        help
            RotaryEncoder uses the PCNT peripheral when the SoC provides it.
            Chips without PCNT use GPIO interrupts. Hardware errors do not
            silently select software. Optional active-low button; see docs/ENCODER.md.

    config MICROCS_SERVO
        bool "Servo driver (C# Servo on a LEDC PWM channel)"
        default y
        help
            The built-in "servo" driver: C# Servo drives hobby servos and ESCs
            with 50 Hz pulses on a PWM channel (LEDC). Turn it off to save
            ~3 KB of flash (Hal.Has("Servo") is then false).

    config MICROCS_U8G2
        bool "U8g2 displays (C# U8g2 / U8x8 on olikraus' u8g2 library)"
        default n
        help
            C# U8g2 and U8x8 for OLED / LCD / e-paper displays (SSD1306, SH1106,
            ST7920, ...) on I2C, SPI or parallel pins (docs/U8G2.md). u8g2 is not
            bundled: its sources come from MICROCS_U8G2_DIR, a copy next to the
            project (u8g2/, third_party/u8g2, ...) or a one-time download of
            u8g2 2.37.1 with MICROCS_U8G2_DOWNLOAD. Only the displays and fonts
            listed below are linked.

    config MICROCS_U8G2_DIR
        string "u8g2 sources (folder with csrc/ or src/clib/)"
        depends on MICROCS_U8G2
        default ""
        help
            A clone of https://github.com/olikraus/u8g2, the U8g2 Arduino library
            or its csrc folder. Empty: look next to the project, then download
            (when allowed below).

    config MICROCS_U8G2_DOWNLOAD
        bool "Download u8g2 2.37.1 when no local copy is found"
        depends on MICROCS_U8G2
        default n
        help
            Fetches the U8g2_Arduino 2.37.1 release once into the build folder
            (also the environment variable MICROCS_U8G2_DOWNLOAD=1).

    config MICROCS_U8G2_DISPLAYS
        string "Displays compiled in (space separated)"
        depends on MICROCS_U8G2
        default ""
        help
            u8g2 setup names without the u8g2_Setup_ prefix and the _f/_1/_2
            suffix, e.g. "ssd1306_i2c_128x64_noname sh1106_i2c_128x64_noname"
            (python3 tools/u8g2.py displays). Empty: the MCS_U8G2_DISPLAYS
            default (SSD1306 128x64 / 128x32, SH1106 128x64).

    config MICROCS_U8G2_FONTS
        string "U8g2 fonts in flash (space separated, the first is the default)"
        depends on MICROCS_U8G2
        default ""
        help
            e.g. "6x10_tf helvB10_tr" (python3 tools/u8g2.py fonts). Every other
            font loads from /fonts/u8g2_font_<name>.bin at run time
            (python3 tools/u8g2.py extract). Empty: six small default fonts.

    config MICROCS_U8X8_FONTS
        string "U8x8 fonts in flash (space separated)"
        depends on MICROCS_U8G2
        default ""

endmenu
```
