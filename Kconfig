## ports/nuttx/Kconfig
```kconfig
#
# MicroCS on Apache NuttX: C# for NuttX targets (NSH command `mcs`).
# Link or copy this folder to apps/interpreters/microcs - see README.md.
#

config INTERPRETERS_MICROCS
	bool "MicroCS C# interpreter"
	default n
	depends on !LIBM_NONE
	select LIBC_FLOATINGPOINT
	select LIBC_LONG_LONG
	---help---
		MicroCS is a small C# compiler and bytecode VM written in portable C99.
		This adds the NSH command `mcs` (REPL, script runner and device shell
		on the NuttX console) and the MicroCS library to the build.
		Files come from the NuttX VFS (any mounted filesystem: LittleFS, FAT,
		SmartFS, hostfs on the simulator...).

		NOTE: the C# Math class needs a full math library (hypot, fma,
		remainder, cbrt, log2...): pick the toolchain's, newlib or OpenLibm
		(Library Routines > Math library). NuttX's small built-in libm does
		not have all of them and fails at link time.

if INTERPRETERS_MICROCS

config INTERPRETERS_MICROCS_PROGNAME
	string "Program name"
	default "mcs"
	---help---
		Name of the NSH built-in command.

config INTERPRETERS_MICROCS_PRIORITY
	int "MicroCS task priority"
	default 100

config INTERPRETERS_MICROCS_STACKSIZE
	int "MicroCS task stack size"
	default 16384
	---help---
		Stack of the `mcs` task. The C# compiler recurses; 16 KB is comfortable,
		8 KB is enough for precompiled images and short scripts.

choice
	prompt "Configuration profile"
	default INTERPRETERS_MICROCS_PROFILE_DEFAULT

config INTERPRETERS_MICROCS_PROFILE_DEFAULT
	bool "Library default (full)"

config INTERPRETERS_MICROCS_PROFILE_EMBEDDED
	bool "embedded"

config INTERPRETERS_MICROCS_PROFILE_MCU
	bool "mcu"

config INTERPRETERS_MICROCS_PROFILE_LOWRAM
	bool "lowram"

config INTERPRETERS_MICROCS_PROFILE_MIN
	bool "min"

endchoice # Configuration profile

config INTERPRETERS_MICROCS_USER_CONFIG_FILE
	string "Project config header"
	default ""
	---help---
		Optional path of a mcs_user_config.h (template: config/mcs_user_config.h
		in the MicroCS repository) that sets any MCS_* option. Use an absolute
		path or one on the include path. MCS_PROFILE in the header wins over the
		profile selected above.

config INTERPRETERS_MICROCS_THREADS
	bool "Real threads on NuttX pthreads (C# Thread.Run / RunOn, SMP CPUs)"
	default n
	depends on !DISABLE_PTHREAD
	---help---
		C# scripts and functions on their own NuttX threads: Thread.Start,
		Thread.Run, Thread.RunOn(cpu, ...) (pinned with the pthread affinity on
		CONFIG_SMP builds), Thread.Every for OS-timed periodic work, Channels
		between threads and `thread core=<n>` jobs in jobs.cfg. Every thread has
		its own VM and heap (MCS_THREAD_HEAP, taken from the NuttX heap) and a
		stack of MCS_THREAD_STACK bytes. Off: MicroCS stays the single-threaded
		runtime. See docs/THREADS.md.

endif # INTERPRETERS_MICROCS
```

## zephyr/Kconfig
```kconfig
config MICROCS
	bool "MicroCS C# runtime"
	select REQUIRES_FULL_LIBC
	help
	  MicroCS: run C# scripts on the device - REPL, filesystem, scheduler
	  and the GPIO/UART/I2C/SPI/ADC/DAC/PWM/Timer/CAN/Watchdog classes.

if MICROCS

config MICROCS_PORT
	bool "Zephyr board port (mcs_zephyr_hal_init)"
	default y
	select GPIO
	imply UART_INTERRUPT_DRIVEN
	imply UART_USE_RUNTIME_CONFIGURE
	imply HWINFO
	imply REBOOT

config MICROCS_USER_CONFIG_FILE
	string "Project config header (mcs_user_config.h)"
	default ""
	help
	  Path of the header with your MCS_* options (template:
	  config/mcs_user_config.h in MicroCS), absolute or relative to the
	  application folder. Empty: mcs_user_config.h in the application
	  folder, its include/ or src/ folder is used when it exists. NONE: no
	  config header. These Kconfig options win over the header, except the
	  profile: MCS_PROFILE in the header wins.

choice MICROCS_PROFILE_CHOICE
	prompt "MicroCS configuration profile"
	default MICROCS_PROFILE_AUTO
	help
	  Which include/profiles/mcs_profile_<name>.h configures the runtime.
	  AUTO picks one from CONFIG_SRAM_SIZE / CONFIG_FLASH_SIZE (16 KB RAM /
	  64 KB flash minimum; see include/profiles/mcs_profile_auto.h).
	  MCS_PROFILE in mcs_user_config.h overrides this choice.

config MICROCS_PROFILE_AUTO
	bool "Auto (from the board's RAM and flash size)"

config MICROCS_PROFILE_FULL
	bool "Full (everything on)"

config MICROCS_PROFILE_EMBEDDED
	bool "Embedded (on-device compiler + REPL, 96 KB+ RAM)"

config MICROCS_PROFILE_MCU
	bool "MCU (precompiled images, 64-96 KB RAM)"

config MICROCS_PROFILE_LOWRAM
	bool "Low-RAM (precompiled images, 32-64 KB RAM)"

config MICROCS_PROFILE_MIN
	bool "Minimum (64 KB flash / 16 KB RAM)"

endchoice

config MICROCS_HEAP_SIZE
	int "C# heap in bytes (example application)"
	default 98304 if ARCH_POSIX || SRAM_SIZE >= 192
	default 65536 if SRAM_SIZE >= 112
	default 40960
	help
	  Size of the static buffer the example application gives the VM.
	  Your own application may ignore it and pass any buffer.

config MICROCS_FS
	bool "Persistent files (LittleFS on the storage partition)"
	default y if FILE_SYSTEM_LITTLEFS
	depends on FILE_SYSTEM
	help
	  The example application mounts LittleFS on the board's
	  `storage_partition` at /lfs and runs /boot.cs, /jobs.cfg and /main.cs
	  from it; MicroCS Studio and tools/mcs_remote.py upload files there.
	  Without it a RAM filesystem of MICROCS_RAMFS_SIZE bytes is used.

config MICROCS_TINYFS
	bool "TinyFS (built in) instead of LittleFS for the persistent files"
	depends on FLASH_MAP
	help
	  The example application puts MicroCS's own small power-fail-safe
	  filesystem on `storage_partition` through mcs_zephyr_flash_area_init()
	  + mcs_flashfs_mount(). Nothing to download or link (MIT). Needs a
	  partition of at least two erase blocks. See overlay-tinyfs.conf.

config MICROCS_YAFFS2
	bool "YAFFS2 instead of LittleFS for the persistent files"
	depends on FLASH_MAP
	help
	  The example application puts YAFFS2 on `storage_partition` through
	  mcs_zephyr_flash_area_init() + mcs_flashfs_mount() instead of mounting
	  Zephyr's LittleFS. The yaffs2 sources are not bundled: pass
	  -DMICROCS_YAFFS2_DIR=<yaffs2 checkout>, keep one in the west
	  workspace (modules/fs/yaffs2) or the application (third_party/yaffs2),
	  or allow the pinned revision to be downloaded with
	  -DMICROCS_FS_DOWNLOAD=ON (cmake/MicroCSFS.cmake). YAFFS2 is GPLv2 (or
	  a commercial licence from Aleph One): linking it puts the firmware
	  under those terms. See overlay-yaffs2.conf.

config MICROCS_WS2812
	bool "WS2812 / NeoPixel driver (C# LedStrip on the led-strip alias)"
	default y
	help
	  The built-in "ws2812" driver: C# LedStrip drives the led_strip
	  device aliased `led-strip` in the devicetree (worldsemi,ws2812-spi,
	  -gpio, -i2s, -rpi_pico-pio ...). Needs CONFIG_LED_STRIP=y; without
	  the alias the class is not registered.

config MICROCS_SERVO
	bool "Servo driver (C# Servo on a PWM channel)"
	default y
	help
	  The built-in "servo" driver: C# Servo drives hobby servos and ESCs
	  with 50 Hz pulses on the board's PWM channels (the `pwms` of the
	  MicroCS PWM node). Turn it off to save ~3 KB of flash.

config MICROCS_THREADS
	bool "Real threads on Zephyr threads (C# Thread.Run / RunOn, SMP cores)"
	default n
	select DYNAMIC_THREAD
	select DYNAMIC_THREAD_ALLOC
	select THREAD_STACK_INFO
	imply SCHED_CPU_MASK if SMP
	imply THREAD_NAME
	help
	  C# scripts and functions on their own Zephyr threads: Thread.Start,
	  Thread.Run, Thread.RunOn(cpu, ...) (pinned with CONFIG_SCHED_CPU_MASK
	  on SMP boards), Thread.Every for kernel-timed periodic work, Channels
	  between threads and `thread core=<n>` jobs in jobs.cfg. Every thread
	  has its own VM and heap (MCS_THREAD_HEAP) and a stack from the system
	  heap (CONFIG_HEAP_MEM_POOL_SIZE must hold MCS_THREADS_MAX stacks of
	  MCS_THREAD_STACK bytes; see overlay-threads.conf). Off: MicroCS stays
	  the single-threaded runtime. See docs/THREADS.md.

config MICROCS_RAMFS_SIZE
	int "RAM filesystem size when there is no persistent filesystem"
	default 16384

config MICROCS_CONSOLE_ECHO
	bool "Echo console input (raw UART terminals)"
	default y

config MICROCS_U8G2
	bool "U8g2 displays (C# U8g2 / U8x8 on olikraus' u8g2 library)"
	help
	  C# U8g2 and U8x8 for OLED / LCD / e-paper displays (SSD1306, SH1106,
	  ST7920, ...) on the MicroCS I2C / SPI buses or GPIO pins
	  (docs/U8G2.md). u8g2 is not bundled: its sources come from
	  MICROCS_U8G2_DIR, a copy next to the application (u8g2/,
	  third_party/u8g2, ...) or a one-time download of u8g2 2.37.1 with
	  MICROCS_U8G2_DOWNLOAD. Only the displays and fonts listed are linked.

config MICROCS_U8G2_DIR
	string "u8g2 sources (folder with csrc/ or src/clib/)"
	depends on MICROCS_U8G2
	default ""

config MICROCS_U8G2_DOWNLOAD
	bool "Download u8g2 2.37.1 when no local copy is found"
	depends on MICROCS_U8G2

config MICROCS_U8G2_DISPLAYS
	string "Displays compiled in (space separated, empty = defaults)"
	depends on MICROCS_U8G2
	default ""
	help
	  e.g. "ssd1306_i2c_128x64_noname sh1106_i2c_128x64_noname"
	  (python3 tools/u8g2.py displays).

config MICROCS_U8G2_FONTS
	string "U8g2 fonts in flash (space separated, the first is the default)"
	depends on MICROCS_U8G2
	default ""
	help
	  e.g. "6x10_tf helvB10_tr" (python3 tools/u8g2.py fonts); other fonts
	  load from /fonts/u8g2_font_<name>.bin (python3 tools/u8g2.py extract).

config MICROCS_U8X8_FONTS
	string "U8x8 fonts in flash (space separated)"
	depends on MICROCS_U8G2
	default ""

endif
```
